## firmware/components/bsp/Kconfig
```kconfig
menu "Gauge BSP"

menu "LCD (2.8 inch 240x320 SPI)"

choice BSP_PANEL
    prompt "Panel controller"
    default BSP_PANEL_ST7789
    help
        The ESP32-2432S028R ships with one of two controllers.  Both are
        driven through the same esp_lcd API; only the init table differs.
        The 2.8" board this project was brought up on has an ST7789V, despite
        the listing claiming an ILI9341 - if the panel stays black or shows
        noise, try the other one.

config BSP_PANEL_ILI9341
    bool "ILI9341"

config BSP_PANEL_ST7789
    bool "ST7789V"

endchoice

config BSP_LCD_RGB_ORDER_BGR
    bool "BGR element order (else RGB)"
    default y if BSP_PANEL_ILI9341
    default n
    help
        Wrong order swaps red and blue while leaving shapes perfect.  The
        verified value for this board's ST7789V is RGB (off).

config BSP_LCD_SPI_HOST
    int "SPI peripheral (1 = SPI2/HSPI, 2 = SPI3/VSPI)"
    range 1 2
    default 2

config BSP_LCD_PIN_SCK
    int "SCLK GPIO"
    default 14

config BSP_LCD_PIN_MOSI
    int "MOSI GPIO"
    default 13

config BSP_LCD_PIN_MISO
    int "MISO GPIO (-1 if not wired)"
    default -1

config BSP_LCD_PIN_CS
    int "CS GPIO"
    default 15

config BSP_LCD_PIN_DC
    int "DC GPIO"
    default 2

config BSP_LCD_PIN_RST
    int "RESET GPIO (-1 if tied to EN)"
    default -1

config BSP_LCD_PIN_BL
    int "Backlight GPIO (-1 to disable)"
    default 21

config BSP_LCD_SPI_CLK_MHZ
    int "SPI clock (MHz)"
    range 10 80
    default 40
    help
        The frame-rate ceiling.  A 320x240 RGB565 frame is 150 KB, so at
        40 MHz a full screen is about 31 ms of SPI; at 80 MHz about 15 ms.
        Raise it a step at a time: if the image tears or goes white, come
        back down.

config BSP_LCD_SWAP_RGB565_BYTES
    bool "Byte-swap RGB565 before SPI transmit"
    default y
    help
        Framebuffers are little-endian RGB565; the panel latches the high byte
        first.  Turn this off only if colours come out wrong but shapes are
        right.

config BSP_LCD_INVERT_COLOR
    bool "Invert colours (INVON)"
    default n
    help
        Enable if the image looks like a photographic negative.  The verified
        value for this board's ST7789V is off.  The BSP only ever sends INVON,
        never INVOFF, so the panel's own init sequence is left alone when this
        is off.

config BSP_LCD_SWAP_XY
    bool "Swap X/Y (landscape)"
    default y

config BSP_LCD_MIRROR_X
    bool "Mirror X"
    default y if BSP_PANEL_ST7789
    default n

config BSP_LCD_MIRROR_Y
    bool "Mirror Y"
    default n

endmenu

config BSP_BACKLIGHT_DEFAULT_PERCENT
    int "Backlight level at boot (0-100)"
    range 0 100
    default 60

menu "Touch (XPT2046)"

config BSP_TOUCH_ENABLE
    bool "Enable touch controller"
    default y

config BSP_TOUCH_SPI_HOST
    int "SPI peripheral (1 = SPI2/HSPI, 2 = SPI3/VSPI)"
    range 1 2
    default 1

config BSP_TOUCH_PIN_SCK
    int "SCLK GPIO"
    default 25

config BSP_TOUCH_PIN_MOSI
    int "MOSI GPIO"
    default 32

config BSP_TOUCH_PIN_MISO
    int "MISO GPIO"
    default 39

config BSP_TOUCH_PIN_CS
    int "CS GPIO"
    default 33

config BSP_TOUCH_PIN_IRQ
    int "IRQ GPIO (-1 to poll instead)"
    default 36

config BSP_TOUCH_SPI_CLK_KHZ
    int "SPI clock (kHz)"
    range 100 4000
    default 1000
    help
        The XPT2046 tops out around 2 MHz.  1 MHz is plenty and keeps the
        sample wiring forgiving.

config BSP_TOUCH_RAW_MIN
    int "Samples below this are treated as noise"
    range 0 512
    default 100

config BSP_TOUCH_RAW_MAX
    int "Samples above this are treated as noise"
    range 3072 4095
    default 4000

endmenu

endmenu
```
